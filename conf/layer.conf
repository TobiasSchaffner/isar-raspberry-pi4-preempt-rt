## conf/layer.conf
```bitbake
#
# Copyright (c) Siemens AG, 2023
#
# SPDX-License-Identifier: MIT

BBPATH .= ":${LAYERDIR}"

BBFILES += "${LAYERDIR}/recipes-*/*/*.bb ${LAYERDIR}/recipes-*/*/*.bbappend"

BBFILE_COLLECTIONS += "raspberry-pi4-preempt-rt"
BBFILE_PATTERN_raspberry-pi4-preempt-rt = "^${LAYERDIR}/recipes-"

LAYERSERIES_COMPAT_raspberry-pi4-preempt-rt = "next"

LAYERDIR_raspberry-pi4-preempt-rt = "${LAYERDIR}"
```

## conf/machine/raspberry-pi4-rt.conf
```bitbake
# Copyright (c) Siemens AG, 2023
#
# SPDX-License-Identifier: MIT

DISTRO_ARCH ?= "arm64"

KERNEL_NAME = "raspberry-pi4-rt"

include conf/machine/rpi-common.conf
```

## conf/machine/raspberry-pi4.conf
```bitbake
# Copyright (c) Siemens AG, 2023
#
# SPDX-License-Identifier: MIT

DISTRO_ARCH ?= "arm64"

WKS_FILE = "raspberry-pi4-sdimg.wks.in"

include conf/machine/rpi-common.conf
```
